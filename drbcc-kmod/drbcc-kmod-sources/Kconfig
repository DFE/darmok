## drbcc-kmod/drbcc-kmod-sources/Kconfig
```kconfig
menuconfig DARMOK_CORE
	tristate "DARMOK driver protocol stack"
	default m 
	help
	  Say Y to enable the customized DResearch DARMOK
	  driver set which allows communication with the 
	  onboard microcontroller

if DARMOK_CORE

config DARMOK_RTC
	tristate "RTC dev node communicating with BCTRL"
	depends on DARMOK_CORE
	help
	  Driver for communication with Hardware RTC connected 
	  to the DARMOK board controller over a serial interface

config DARMOK_RAW
	tristate "Legacy interface between the drbcc cmd line tool and BCTRL"
	depends on DARMOK_CORE
	help
	  Legacy driver as an interface between the old command line drbcc tool and 
	  the serial conntect microcontroller

config DARMOK_WATCHDOG
	tristate "Watchdog device communicating with BCTRL"
	depends on DARMOK_CORE
	help
      Driver for communication with the BCTRL watchdog

config DARMOK_WATCHDOG_TIMEOUT
	int "Watchdog timeout in seconds"
	depends on DARMOK_WATCHDOG
	range 1 65536
	default 60
	help
	  If no ping send within DARMOK_WATCHDOG_TIMEOUT, then a reboot is performed.

config DARMOK_WATCHDOG_KEEPALIVE
	int "Watchdog keep alive interval in seconds"
	depends on DARMOK_WATCHDOG
	range 0 65536
	default 30
	help
	 The driver sends automatically every DARMOK_WATCHDOG_KEEPALIVE time a ping
	 with DARMOK_WATCHDOG_TIMEOUT timeout. If this value set to 0, then the
	 automatic watchdog service is disabled and the user space must handle the
	 watchdog.

endif # DARMOK_CORE
```
